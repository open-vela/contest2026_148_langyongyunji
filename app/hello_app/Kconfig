## app/hello_app/Kconfig
```kconfig
#
# For a description of the syntax of this configuration file,
# see the file kconfig-language.txt in the NuttX tools repository.
#

menuconfig LVX_USE_DEMO_CONTEST2026_148_VELAGUARD
	bool "Contest 2026 team 148 VelaGuard"
	default n
	depends on GRAPHICS_LVGL && LV_USE_NUTTX
	---help---
		Enable VelaGuard, an openvela-based end-side safety guardian
		prototype for the Huangshan Pi SF32LB52 board. It provides an
		LVGL UI, a safety-event state machine, demo fall/voice/sound/SOS
		triggers, rule-based event summaries, and JSON event output on
		the UART console.

if LVX_USE_DEMO_CONTEST2026_148_VELAGUARD

config CONTEST2026_148_VELAGUARD_HEADLESS
	bool "Run VelaGuard without LVGL UI"
	default n
	---help---
		Keep the BLE and audio workers running without initializing the
		LVGL display. This is intended for isolating BLE startup issues.

config CONTEST2026_148_VELAGUARD_PRIORITY
	int "VelaGuard task priority"
	default 100

config CONTEST2026_148_VELAGUARD_STACKSIZE
	int "VelaGuard stack size"
	default 32768

config CONTEST2026_148_VELAGUARD_INPUT_DEVPATH
	string "Touchscreen device path"
	default "/dev/input0"
	depends on INPUT_TOUCHSCREEN

config CONTEST2026_148_VELAGUARD_BUTTON_DEVPATH
	string "Button device path"
	default "/dev/buttons"
	depends on INPUT_BUTTONS

config CONTEST2026_148_VELAGUARD_IMU_DEVPATH
	string "IMU sensor device path"
	default "/dev/lsm6dsl0"
	depends on I2C_DRIVER

config CONTEST2026_148_VELAGUARD_IMU_LEGACY_I2C
	bool "Use legacy direct-I2C IMU access (shared I2C1 + pin mux)"
	default n
	depends on I2C_DRIVER
	---help---
		When enabled, VelaGuard talks to the LSM6DS3TR-C directly over
		the raw I2C bus shared with the touch controller (I2C1) using
		GPIO30/pin-mux switching.  Kept for reference only; the default
		uses the kernel LSM6DSL driver on the dedicated I2C3 bus
		(/dev/lsm6dsl0).

config CONTEST2026_148_VELAGUARD_COUNTDOWN
	int "Pre-alert countdown in seconds"
	default 10

config CONTEST2026_148_VELAGUARD_HISTORY_SIZE
	int "Number of events kept in memory"
	default 5
	range 1 8

config CONTEST2026_148_VELAGUARD_INPUT_POLL_MS
	int "Touch input polling period in milliseconds"
	default 16
	range 5 100
	depends on INPUT_TOUCHSCREEN

config CONTEST2026_148_VELAGUARD_LOOP_SLEEP_MAX_MS
	int "Maximum sleep time of the LVGL main loop in milliseconds"
	default 8
	range 1 33

config CONTEST2026_148_AUDIO_TEST
	bool "Audio test command (audio_test)"
	default y
	---help---
		Enable the audio_test NSH command.  Runs at the NSH prompt:
		  audio_test [duration_ms]
		Initialises AUDCODEC PLL/DAC, enables AW8155 PA, plays a 1 kHz
		test tone through the speaker, and prints key diagnostics to
		the serial console.

config CONTEST2026_148_AUDIO_FEEDBACK
	bool "Audio feedback for SOS events (WAV files)"
	default y
	depends on AUDIO
	---help---
		Play pre-recorded WAV files through the speaker when a
		distress call is triggered or fails.  WAV files are stored
		in ROMFS at /etc/data/audio/.
		Requires: success.wav and failure.wav (16kHz, 16-bit, mono PCM).

config CONTEST2026_148_MIC_CAPTURE
	bool "Microphone capture and voice-trigger processing"
	default y
	depends on AUDIO
	---help---
		Start the ADC microphone stream and run voice activity / keyword
		processing.  This is independent from SOS WAV speaker feedback and
		can be disabled while validating DAC playback on SF32LB52.

config CONTEST2026_148_DENOISE
	bool "Noise suppression for MIC capture (speexdsp preprocess)"
	default y
	depends on AUDIO
	---help---
		Enable real-time noise suppression on the recorded microphone
		stream (VelaGuard capture and the audio_test recorder).  Uses
		the vendored libspeexdsp preprocessor (Ephraim-Malah spectral
		subtraction): suppresses stationary environmental noise while
		preserving speech detail.  When disabled, the raw microphone
		samples are used as-is.

endif # LVX_USE_DEMO_CONTEST2026_148_VELAGUARD
```
